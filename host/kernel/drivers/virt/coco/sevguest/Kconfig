## host/kernel/drivers/virt/coco/sevguest/Kconfig
```kconfig
config SEV_GUEST
	tristate "AMD SEV Guest driver"
	default y
	depends on AMD_MEM_ENCRYPT && CRYPTO_AEAD2
	help
	  The driver can be used by the SEV-SNP guest to communicate with the PSP to
	  request the attestation report and more.

	  If you choose 'M' here, this module will be called sevguest.
```
